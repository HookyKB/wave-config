/*
 * Copyright (c) 2023 ZMK
 *
 * SPDX-License-Identifier: MIT
 */

#include "intro.dtsi"

&kscan0 {
    gpios
        , <&pro_micro 2 (GPIO_ACTIVE_HIGH | GPIO_PULL_DOWN)>
        , <&pro_micro 3 (GPIO_ACTIVE_HIGH | GPIO_PULL_DOWN)>
        , <&pro_micro 4 (GPIO_ACTIVE_HIGH | GPIO_PULL_DOWN)>
        ;
};