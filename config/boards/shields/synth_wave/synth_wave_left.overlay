/*
 * Copyright (c) 2023 ZMK
 *
 * SPDX-License-Identifier: MIT
 */

#include "synth_wave.dtsi"

&kscan0 {
    col-gpios
        = <&pro_micro 4 (GPIO_ACTIVE_HIGH | GPIO_PULL_DOWN)>
        , <&pro_micro 5 (GPIO_ACTIVE_HIGH | GPIO_PULL_DOWN)>
        , <&pro_micro 6 (GPIO_ACTIVE_HIGH | GPIO_PULL_DOWN)>
        ;
};