## config/app/boards/shields/synth_wave_left/Kconfig.shield
```kconfig
# Copyright (c) 2023 ZMK
# SPDX-License-Identifier: MIT

config SHIELD_SYNTH_WAVE_LEFT
	def_bool $(shields_list_contains,synth-wave-left)
```

## config/app/boards/shields/synth_wave_right/Kconfig.defconf
```kconfig
# Copyright (c) 2023 ZMK
# SPDX-License-Identifier: MIT

config ZMK_USB
	default y

if SHIELD__SYNTH_WAVE_LEFT || SHIELD__SYNTH_WAVE_RIGHT

config ZMK_SPLIT
	default y

endif
```

## config/boards/shields/synth-wave/Kconfig.defconf
```kconfig
# Copyright (c) 2023 ZMK
# SPDX-License-Identifier: MIT

config ZMK_USB
	default y

if SHIELD_SYNTH-WAVE-LEFT

config ZMK_KEYBOARD_NAME
	default "Synth Wave"

config ZMK_SPLIT_ROLE_CENTRAL
	default y

endif

if SHIELD__SYNTH-WAVE-LEFT || SHIELD__SYNTH-WAVE-RIGHT

config ZMK_SPLIT
	default y

endif
```

## config/boards/shields/synth-wave/Kconfig.shield
```kconfig
# Copyright (c) 2023 ZMK
# SPDX-License-Identifier: MIT

config SHIELD_SYNTH-WAVE-LEFT
	def_bool $(shields_list_contains,synth-wave-left)

config SHIELD_SYNTH-WAVE-RIGHT
	def_bool $(shields_list_contains,synth-wave-right)
```

## config/boards/shields/synth_wave/Kconfig.defconfig
```kconfig
# Copyright (c) 2023 ZMK
# SPDX-License-Identifier: MIT

config ZMK_KSCAN_CHARLIEPLEX_WAIT_BEFORE_INPUTS
	default 10
config ZMK_KSCAN_CHARLIEPLEX_WAIT_BETWEEN_OUTPUTS
	default 10

config ZMK_USB_LOGGING
	default y

if SHIELD_SYNTH_WAVE_LEFT

config ZMK_KEYBOARD_NAME
	default "Synth Wave"

config ZMK_SPLIT_ROLE_CENTRAL
	default y

endif

if SHIELD_SYNTH_WAVE_LEFT || SHIELD_SYNTH_WAVE_RIGHT

config ZMK_SPLIT
	default y

endif
```

## config/boards/shields/synth_wave_left/Kconfig.defconf
```kconfig
# Copyright (c) 2023 ZMK
# SPDX-License-Identifier: MIT

config ZMK_USB
	default y

if SHIELD_SYNTH_WAVE_LEFT

config ZMK_KEYBOARD_NAME
	default "Synth Wave"

config ZMK_SPLIT_ROLE_CENTRAL
	default y

endif

if SHIELD__SYNTH_WAVE_LEFT

config ZMK_SPLIT
	default y

endif
```

## config/west.yml
```yaml
manifest:
  remotes:
    - name: zmkfirmware
      url-base: https://github.com/HookyKB/zmk/tree/kscan/round_robin
  projects:
    - name: zmk
      remote: zmkfirmware
      revision: main
      import: app/west.yml
  self:
    path: config
```
